## drivers/display/Kconfig.gc9x01x
```kconfig
# Copyright 2023 Martin Kiepfer <mrmarteng@teleschirm.org>
# SPDX-License-Identifier: Apache-2.0

config GC9X01X
	bool
	default y if DT_HAS_GALAXYCORE_GC9X01X_ENABLED
	select MIPI_DBI
	help
	  Hidden config selected by all GC9X01X-family display drivers.

config GC9101A
	bool "GC9101A display driver"
	default y
	depends on DT_HAS_GALAXYCORE_GC9101A_ENABLED
	select GC9X01X
	help
	  Enable driver for GC9101A display controller (compatible
	  galaxycore,gc9101a). Defaults match the Waveshare 1.28" 240x240
	  round LCD panel.

config GC9D01N
	bool "GC9D01N display driver"
	default y
	depends on DT_HAS_GALAXYCORE_GC9D01N_ENABLED
	select GC9X01X
	help
	  Enable driver for GC9D01N display controller (compatible
	  galaxycore,gc9d01n). Defaults match the BOE NT071BB-C12 0.71"
	  160x160 round LCD panel.
```

## dts/bindings/display/galaxycore,gc9101a.yaml
```yaml
# Copyright (c) 2023 Mr Beam Lasers GmbH.
# Copyright (c) 2023 Amrith Venkat Kesavamoorthi <amrith@mr-beam.org>
# Copyright (c) 2023 Martin Kiepfer <mrmarteng@teleschirm.org>
# SPDX-License-Identifier: Apache-2.0

title: GC9101A display controller (galaxycore,gc9101a)

description: |
  GalaxyCore GC9101A TFT LCD display controller. Defaults match the
  Waveshare 1.28" 240x240 round LCD panel.

compatible: "galaxycore,gc9101a"

include: "galaxycore,gc9x01x-common.yaml"

properties:
  pwrctrl2:
    type: uint8-array
    default: [0x13]
    description: Power-control 2 register (0xC3) value

  pwrctrl3:
    type: uint8-array
    default: [0x13]
    description: Power-control 3 register (0xC4) value

  pwrctrl4:
    type: uint8-array
    default: [0x22]
    description: Power-control 4 register (0xC9) value

  gamma1:
    type: uint8-array
    default: [0x45, 0x09, 0x08, 0x08, 0x26, 0x2A]
    description: Gamma correction 1 register (0xF0, negative polarity) values

  gamma2:
    type: uint8-array
    default: [0x43, 0x70, 0x72, 0x36, 0x37, 0x6F]
    description: Gamma correction 2 register (0xF1) values

  gamma3:
    type: uint8-array
    default: [0x45, 0x09, 0x08, 0x08, 0x26, 0x2A]
    description: Gamma correction 3 register (0xF2, positive polarity) values

  gamma4:
    type: uint8-array
    default: [0x43, 0x70, 0x72, 0x36, 0x37, 0x6F]
    description: Gamma correction 4 register (0xF3) values

  framerate:
    type: uint8-array
    default: [0x34]
    description: Frame rate control register (0xE8) value
```

## dts/bindings/display/galaxycore,gc9d01n.yaml
```yaml
# Copyright (c) 2024 NIU Technologies
# SPDX-License-Identifier: Apache-2.0

title: GC9D01N display controller (galaxycore,gc9d01n)

description: |
  GalaxyCore GC9D01N TFT LCD display controller. Defaults match the
  BOE NT071BB-C12 0.71" 160x160 round LCD panel.

compatible: "galaxycore,gc9d01n"

include: "galaxycore,gc9x01x-common.yaml"

properties:
  pwrctrl2:
    type: uint8-array
    default: [0x18]
    description: |
      Power-control 2 register (0xC3) value. Adjusts AVDD/VCL voltage level.
      Default 0x18 is tuned for BOE NT071BB-C12 panel.

  pwrctrl3:
    type: uint8-array
    default: [0x18]
    description: |
      Power-control 3 register (0xC4) value. Adjusts VGH/VGL voltage level.
      Default 0x18 is tuned for BOE NT071BB-C12 panel.

  pwrctrl4:
    type: uint8-array
    default: [0x3C]
    description: Power-control 4 register (0xC9) value. VCOM voltage setting.

  gamma1:
    type: uint8-array
    default: [0x13, 0x15, 0x04, 0x05, 0x01, 0x38]
    description: |
      Gamma correction 1 register (0xF0, negative polarity) values.
      Default tuned for BOE NT071BB-C12 panel.

  gamma2:
    type: uint8-array
    default: [0x4B, 0xB8, 0x7B, 0x34, 0x35, 0xEF]
    description: |
      Gamma correction 2 register (0xF1) values.
      Default tuned for BOE NT071BB-C12 panel.

  gamma3:
    type: uint8-array
    default: [0x13, 0x15, 0x04, 0x05, 0x01, 0x34]
    description: |
      Gamma correction 3 register (0xF2, positive polarity) values.
      Default tuned for BOE NT071BB-C12 panel.

  gamma4:
    type: uint8-array
    default: [0x47, 0xB4, 0x72, 0x34, 0x35, 0xDA]
    description: |
      Gamma correction 4 register (0xF3) values.
      Default tuned for BOE NT071BB-C12 panel.
```

## dts/bindings/display/galaxycore,gc9x01x-common.yaml
```yaml
# Copyright (c) 2023 Mr Beam Lasers GmbH.
# Copyright (c) 2023 Martin Kiepfer <mrmarteng@teleschirm.org>
# SPDX-License-Identifier: Apache-2.0

title: GC9X01X family display controllers - common properties

description: |
  Common properties shared by all GalaxyCoreIC GC9X01X-family display
  controllers (GC9101A, GC9D01N, ...).

include: [mipi-dbi-spi-device.yaml, display-controller.yaml, lcd-controller.yaml]

properties:
  orientation:
    type: string
    default: "normal"
    enum:
      - "normal"
      - "90"
      - "180"
      - "270"
    description: Display rotation (CW) in degrees.

  display-inversion:
    type: boolean
    description: |
      Display inversion mode. Every bit is inverted from the frame memory to
      the display.
```
